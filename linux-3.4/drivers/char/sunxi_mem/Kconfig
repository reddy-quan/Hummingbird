## linux-3.4/drivers/char/sunxi_mem/Kconfig
```kconfig
#
# sunxi continous physic memory allocator.
#

config SUNXI_PHYS_MEM_ALLOCATOR
	bool "sunxi continous physic memory allocator"
	default n
	help
	Nothing help.
```

## linux-3.4/drivers/gpu/ion/Kconfig
```kconfig
menuconfig ION
	tristate "Ion Memory Manager"
	select GENERIC_ALLOCATOR
	select DMA_SHARED_BUFFER
	help
	  Chose this option to enable the ION Memory Manager.

config ION_TEGRA
	tristate "Ion for Tegra"
	depends on ARCH_TEGRA && ION
	help
	  Choose this option if you wish to use ion on an nVidia Tegra.

config ION_SUN7I
	bool "ion for sunxi"
	depends on ARCH_SUN7I && ION
	help
	  ION for sunxi platforms.

config ION_SUNXI_CARVEOUT_SIZE_1G
	int "memory size(in MB) for sunxi carveout ion heap."
	default 128
	depends on ION_SUN7I
	help
	  Select memory size for sunxi carveout ion heap(1G memory total), the memory is used by modules that need physical continous memory, such as gpu and ve...
	  Examples:
		100 => reserve 100M bytes memory for carveout heap.
		230 => reserve 230M bytes memory for carveout heap.
config ION_SUNXI_CARVEOUT_SIZE_512M
        int "memory size(in MB) for sunxi carveout ion heap."
        default 80
        depends on ION_SUN7I
        help
          Select memory size for sunxi carveout ion heap(512M memory total), the memory is used by modules that need physical continous memory, such as gpu and ve...
          Examples:
                100 => reserve 100M bytes memory for carveout heap.
                230 => reserve 230M bytes memory for carveout heap.
```
